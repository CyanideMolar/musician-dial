## sdkconfig.defaults
```kconfig
# Board: Waveshare ESP32-S3-Touch-LCD-2.1 (8MB octal PSRAM, 16MB flash)
CONFIG_SPIRAM=y
CONFIG_SPIRAM_MODE_OCT=y
CONFIG_SPIRAM_SPEED_80M=y

CONFIG_ESPTOOLPY_FLASHSIZE_16MB=y
CONFIG_PARTITION_TABLE_CUSTOM=y
CONFIG_PARTITION_TABLE_CUSTOM_FILENAME="partitions.csv"

# ESP-IDF's Kconfig default here is 100Hz (10ms/tick). main.c's main loop
# calls `vTaskDelay(pdMS_TO_TICKS(5))`, intending a 5ms cadence -- but
# pdMS_TO_TICKS() truncates to whole ticks, so at 100Hz that's
# (5*100)/1000 = 0 ticks, i.e. vTaskDelay(0). That doesn't block for any
# real time, just yields once -- confirmed on real hardware by a heap-stats
# log meant to fire every ~60s (12000 iterations at the intended 5ms each)
# instead firing every ~280ms, meaning the loop was actually running ~200x
# faster than every "runs every 5ms" comment in this codebase assumes.
# Investigating a UI freeze partway into a long-running practice session --
# this main loop drives touch polling, LVGL redraws, and every *_Tick()
# function in the app, so running it 200x hotter than intended for 15+
# minutes straight is a very plausible way to exhaust something. 1000Hz
# makes pdMS_TO_TICKS(5) actually equal 5 ticks, matching what the existing
# code already assumes everywhere -- no call-site changes needed.
CONFIG_FREERTOS_HZ=1000

# LVGL: RGB565 to match the panel's 16-bit parallel bus
CONFIG_LV_COLOR_DEPTH_16=y

# Fonts used by the metronome UI + Circle of Fifths screen
CONFIG_LV_FONT_MONTSERRAT_14=y
CONFIG_LV_FONT_MONTSERRAT_18=y
CONFIG_LV_FONT_MONTSERRAT_24=y
CONFIG_LV_FONT_MONTSERRAT_28=y
CONFIG_LV_FONT_MONTSERRAT_32=y
CONFIG_LV_FONT_MONTSERRAT_48=y

# Default 3.5KB main-task stack overflows while MetronomeUI_Create() builds
# the widget tree (confirmed on real hardware: "stack overflow in task main"
# right after LVGL init). Give it real headroom.
CONFIG_ESP_MAIN_TASK_STACK_SIZE=12288

# Default redraw-timer period (33ms, ~30Hz) makes the pendulum needle's
# +-60 degree sweep visibly choppy since it only gets ~15 animation steps
# per beat. Our main loop already polls lv_timer_handler() every 5ms, so
# let LVGL actually redraw that often too.
CONFIG_LV_DEF_REFR_PERIOD=5

# ESP-IDF's own default for this chip is 160MHz. This is USB-powered and
# sitting on a stand, not battery-run, so there's no reason to leave ~1/3
# of the CPU's headroom for LVGL rendering / touch polling / the metronome
# timer on the table for power savings that don't matter here.
CONFIG_ESP_DEFAULT_CPU_FREQ_MHZ_240=y
CONFIG_ESP_DEFAULT_CPU_FREQ_MHZ=240

# lv_snapshot_take() for the on-device screenshot feature (main/Debug).
CONFIG_LV_USE_SNAPSHOT=y

# lv_qrcode for the Guitar Vault pairing screen (main/Pairing).
CONFIG_LV_USE_QRCODE=y

# LVGL's own allocator (lv_malloc) uses a fixed-size pool, separate from the
# rest of the heap -- widget structs, styles, animations, and label text
# buffers (e.g. the practice-session timer's lv_label_set_text() call, once
# a second for as long as a session runs) all come out of it. The Kconfig
# default is only 64KB; investigating a real-hardware freeze during a long
# practice session (17-18 minutes in) that's consistent with this pool
# fragmenting/exhausting under sustained once-a-second reallocation on top
# of every other widget this app already creates across 4 tiles + Settings
# sub-pages + the review dialog. Doubled for headroom -- PSRAM is otherwise
# barely used (see LVGL_Driver.c's draw buffers), so this costs nothing.
CONFIG_LV_MEM_SIZE_KILOBYTES=128

# ESP-IDF's default console channel is UART0, which isn't wired to anything
# on this board -- there's no CH343 bridge despite what Waveshare's docs
# claim (see README), so UART0 just floats. The only channel that's ever
# actually worked for logs/flashing this whole project is the native USB
# Serial/JTAG controller. Making it the PRIMARY console (not just the
# secondary mirror ESP-IDF defaults to alongside UART0) gives us a working
# stdin on that same port, which the screenshot feature needs to receive
# its trigger command from the host.
CONFIG_ESP_CONSOLE_USB_SERIAL_JTAG=y
```
